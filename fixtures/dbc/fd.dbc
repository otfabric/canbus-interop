VERSION "canbus-interop fixtures 1.0"

NS_ :

BS_:

BU_: ECU1

BO_ 1536 FdMsg: 64 ECU1
 SG_ First : 0|8@1+ (1,0) [0|255] "" Vector__XXX
 SG_ Mid : 256|32@1+ (0.5,0) [0|2147483647.5] "" Vector__XXX
 SG_ MotoFar : 415|16@0- (1,0) [-32768|32767] "" Vector__XXX
 SG_ Last : 504|8@1+ (1,0) [0|255] "" Vector__XXX

BO_ 2147489281 FdExt: 12 ECU1
 SG_ X : 32|64@1+ (1,0) [0|18446744073709551615] "" Vector__XXX
 SG_ Head : 0|32@1+ (1,0) [0|4294967295] "" Vector__XXX

CM_ "Fixture of canbus-interop: CAN FD messages of 64 and 12 bytes.";
BA_DEF_ BO_ "VFrameFormat" ENUM "StandardCAN","ExtendedCAN","reserved","reserved","reserved","reserved","reserved","reserved","reserved","reserved","reserved","reserved","reserved","reserved","StandardCAN_FD","ExtendedCAN_FD";
BA_DEF_ "BusType" STRING ;
BA_DEF_DEF_ "VFrameFormat" "StandardCAN";
BA_DEF_DEF_ "BusType" "CAN FD";
BA_ "VFrameFormat" BO_ 1536 14;
BA_ "VFrameFormat" BO_ 2147489281 15;
