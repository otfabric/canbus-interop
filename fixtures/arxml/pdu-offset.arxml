AUTOSAR XML (schema 4-3-0)
# SPDX-License-Identifier: MIT
# canbus-interop fixture: A PDU mapped at byte 2 of its frame (PDU-TO-FRAME-MAPPING START-POSITION 16). Neither cantools 45.1.1 nor canmatrix 1.3.3 applies the offset: see docs/FIXTURES.md; consumers cannot use them as oracles for it
standard types defined: sint8, sint16, sint32
package /Cluster
  can cluster Offset: baudrate=500000
    can physical channel Channel
      frame Shifted: id 0x300, frame-length=8, can-addressing-mode=STANDARD
        carries pdu ShiftedPdu: packing-byte-order=little-endian, start-position=16
        pdu ShiftedPdu: length=4
          signal A: start 0, 8 bit, little-endian, transfer-property=PENDING
          signal B: start 8, 16 bit, little-endian, transfer-property=PENDING
package /CompuMethods
  compu method Unused: identical
package /Units
  unit rpm: display-name=rpm
