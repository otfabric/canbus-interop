AUTOSAR XML (schema 4-3-0)
# SPDX-License-Identifier: MIT
# canbus-interop fixture: AUTOSAR 4 CAN FD frames (CAN-FRAME-TX-BEHAVIOR CAN-FD) of 64 and 12 bytes, standard and extended
standard types defined: sint8, sint16, sint32
package /Cluster
  can cluster Chassis: baudrate=500000
    can physical channel Channel
      frame FdLong: id 0x200, frame-length=64, can-addressing-mode=STANDARD, can-frame-rx-behavior=CAN-FD, can-frame-tx-behavior=CAN-FD
        pdu FdLongPdu: length=64
          signal First: start 0, 8 bit, little-endian, transfer-property=PENDING
          signal Word: start 263, 32 bit, big-endian, compu {phys=raw*0.001}, transfer-property=PENDING
          signal Signed: start 400, 32 bit, little-endian, base-type=sint32, transfer-property=PENDING
          signal Last: start 504, 8 bit, little-endian, transfer-property=PENDING
      frame FdShort: id 0x1ABC0000, frame-length=12, can-addressing-mode=EXTENDED, can-frame-rx-behavior=CAN-FD, can-frame-tx-behavior=CAN-FD
        pdu FdShortPdu: length=12
          signal Head: start 0, 32 bit, little-endian, transfer-property=PENDING
          signal Tail: start 71, 16 bit, big-endian, compu {phys=raw*0.1-1000}, transfer-property=PENDING
package /Units
  unit rpm: display-name=rpm
